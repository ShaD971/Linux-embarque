## external/configs/linux_embarque_defconfig
```kconfig
# Raspberry Pi 3 Model B/B+, ARM 32-bit userspace
BR2_arm=y
BR2_cortex_a53=y
BR2_ARM_FPU_NEON_VFPV4=y
BR2_TOOLCHAIN_BUILDROOT_GLIBC=y
BR2_PACKAGE_HOST_LINUX_HEADERS_CUSTOM_6_6=y

BR2_TARGET_GENERIC_HOSTNAME="linux-embarque"
BR2_TARGET_GENERIC_ISSUE="Linux-embarque"
# BR2_TARGET_ENABLE_ROOT_LOGIN is not set
BR2_SYSTEM_DHCP="eth0"
BR2_ROOTFS_OVERLAY="$(BR2_EXTERNAL_LINUX_EMBARQUE_PATH)/board/linux-embarque/rootfs-overlay"
BR2_ROOTFS_POST_BUILD_SCRIPT="$(BR2_EXTERNAL_LINUX_EMBARQUE_PATH)/board/linux-embarque/post-build.sh"
BR2_ROOTFS_POST_IMAGE_SCRIPT="$(BR2_EXTERNAL_LINUX_EMBARQUE_PATH)/board/linux-embarque/post-image.sh"

BR2_LINUX_KERNEL=y
BR2_LINUX_KERNEL_CUSTOM_VERSION=y
BR2_LINUX_KERNEL_CUSTOM_VERSION_VALUE="6.6.144"
BR2_LINUX_KERNEL_DEFCONFIG="multi_v7"
BR2_LINUX_KERNEL_CONFIG_FRAGMENT_FILES="$(BR2_EXTERNAL_LINUX_EMBARQUE_PATH)/board/linux-embarque/linux.config"
BR2_LINUX_KERNEL_DTS_SUPPORT=y
BR2_LINUX_KERNEL_INTREE_DTS_NAME="broadcom/bcm2837-rpi-3-b broadcom/bcm2837-rpi-3-b-plus"
BR2_LINUX_KERNEL_ZIMAGE=y

BR2_PACKAGE_RPI_FIRMWARE=y
BR2_PACKAGE_RPI_FIRMWARE_BOOTCODE_BIN=y
BR2_PACKAGE_RPI_FIRMWARE_VARIANT_PI=y
BR2_PACKAGE_RPI_FIRMWARE_CONFIG_FILE="$(BR2_EXTERNAL_LINUX_EMBARQUE_PATH)/board/linux-embarque/config_3.txt"
BR2_PACKAGE_RPI_FIRMWARE_CMDLINE_FILE="$(BR2_EXTERNAL_LINUX_EMBARQUE_PATH)/board/linux-embarque/cmdline.txt"
BR2_PACKAGE_RPI_FIRMWARE_INSTALL_DTB_OVERLAYS=y
BR2_PACKAGE_BUSYBOX_SHOW_OTHERS=y
BR2_PACKAGE_XZ=y
BR2_PACKAGE_KMOD=y
BR2_PACKAGE_KMOD_TOOLS=y
BR2_PACKAGE_HELLOWORLD=y

BR2_TARGET_ROOTFS_EXT2=y
BR2_TARGET_ROOTFS_EXT2_4=y
BR2_TARGET_ROOTFS_EXT2_SIZE="192M"
# BR2_TARGET_ROOTFS_TAR is not set
BR2_PACKAGE_HOST_DOSFSTOOLS=y
BR2_PACKAGE_HOST_GENIMAGE=y
BR2_PACKAGE_HOST_KMOD_XZ=y
BR2_PACKAGE_HOST_MTOOLS=y
```

## external/package/Config.in
```kconfig
menu "Linux-embarque packages"
source "$BR2_EXTERNAL_LINUX_EMBARQUE_PATH/package/helloworld/Config.in"
source "$BR2_EXTERNAL_LINUX_EMBARQUE_PATH/package/lvgl_dashboard/Config.in"
endmenu
```

## external/package/helloworld/Config.in
```kconfig
config BR2_PACKAGE_HELLOWORLD
	bool "helloworld"
	help
	  Small local program preserved from the historical student project.
	  It prints a deterministic greeting and has no network dependency.
```

## external/package/lvgl_dashboard/Config.in
```kconfig
config BR2_PACKAGE_LVGL_DASHBOARD
	bool "lvgl_dashboard"
	depends on BR2_TOOLCHAIN_HAS_THREADS
	select BR2_PACKAGE_LIBDRM
	help
	  Dashboard graphique LVGL v9 (rendu DRM/KMS, acceleration NEON)
	  pour la Raspberry Pi 4. Affichage seul (CPU, RAM, temperature,
	  reseau, horloge), sans dependance a un ecran tactile.

	  Le code applicatif est versionne avec ce package. Les sources
	  LVGL sont telechargees separement depuis leur depot public a
	  une revision figee et verifiee par hash.
```
